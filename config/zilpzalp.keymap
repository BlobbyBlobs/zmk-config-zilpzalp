#ifdef ZILPZALP_BLE_FLAG
#include <dt-bindings/zmk/bt.h>
#include <dt-bindings/zmk/outputs.h>
#endif

#include "base_zilpzalp.h"


// zilpzalp key numbers
//     __________________________  __________________________
//    /     0  |  1  |  2  |  3  \/   4 |   5 |   6 |   7    \
// |  8  |  9  | 10  | 11  | 12  /\  13 |  14 |  15 |  16 | 17  |
//    \    18  | 19  | 20    /        \    21 |  22 |  23   /
//          \    24  | 25  /            \  26 |  27    /
//           --------------              --------------

/ {

    keymap {
        compatible = "zmk,keymap";

        bird {
            label = "BIRD";

            bindings = <
                        &kp C   &kp L   &kp F   &kp P   &kp K   &kp Y   &kp O   &kp U
                &kp R   &kp S   &kp N   &kp T   &kp B   &kp J   &kp H   &kp E   &kp I   &kp A
                        &kp W   &kp M   &kp G                   &kp D   &comsem &dotcol
                             &mo NUM &spc_lt NAV SPACE &shift_bp LSHIFT BSPC &mo SYM
            >;
        };
        numbers {
            label = "NUM";

            bindings = <
                        &none                 &isk LGUI LGUI     &kp TAB     &none           &none    &kp N7   &kp N8   &kp N9
                &none   &isk LALT LALT   &isk LCTRL LCTRL   &isk LSHIFT LSHFT      &none    &none   &kp N4   &kp N5   &kp N6   &none
                        &none           &isk LC(LS(LALT)) LC(LS(LALT)) &none                                  &kp N1   &kp N2   &kp N3
                                                                         &trans  &trans           &kp N0         &trans
            >;
        };
        navigation {
            label = "NAV";

            bindings = <
                        &none     &isk LGUI LGUI     &kp TAB     &none      &none   &kp PG_UP   &kp UP     &kp PG_DN
                &none   &isk LALT LALT  &isk LCTRL LCTRL    &isk LSHFT LSHFT   &none      &none   &kp LEFT    &kp DOWN   &kp RIGHT   &none
                        &none &isk LC(LS(LALT)) LC(LS(LALT)) &none                          &kp HOME    &kp INS    &kp END     
                                                       &trans &trans         &trans &trans 
            >;
        };
        symbols {
            label = "SYM";

             bindings = <
                        &kp EXCL   &kp DLLR    &kp GRAVE   &none      &none   &kp FSLH    &kp UNDER   &kp AT
                &none   &kp BSLH   &kp MINUS   &kp HASH    &none      &none   &kp PRCNT   &kp EQUAL   &kp PIPE   &none
                        &kp COLON  &kp STAR    &kp PLUS                       &kp AMPS    &kp CARET   &kp TILDE
                                               &trans     &trans       &trans   &trans
            >;
        };

#ifdef ZILPZALP_BLE_FLAG
        function {
            label = "FUN";

            bindings = <
                               &bootloader    &trans         &bt BT_CLR_ALL &bt BT_PRV         &kp F12        &kp F7         &kp F8         &kp F9
                &trans         &bt BT_SEL 2   &bt BT_SEL 1   &bt BT_SEL 0   &bt BT_NXT         &kp F11        &kp F4         &kp F5         &kp F6         &kp F10
                               &out OUT_TOG   &trans         &trans                                       &kp F1         &kp F2         &kp F3
                                                             &trans         &trans         &trans         &trans
            >;

#endif
#ifndef ZILPZALP_BLE_FLAG
        function {
            label = "FUN";

            bindings = <
                               &bootloader    &trans         &trans         &trans         &kp F12        &kp F7         &kp F8         &kp F9
                &trans         &trans         &trans         &trans         &trans         &kp F11        &kp F4         &kp F5         &kp F6         &kp F10
                               &trans         &trans         &trans                                       &kp F1         &kp F2         &kp F3
                                                             &trans         &trans         &trans         &trans
            >;
#endif
        };

    };
};

//     __________________________  __________________________
//    /     1  |  2  |  3  |  4  \/   5 |   6 |   7 |   8    \
// | 10  | 11  | 12  | 13  | 14  ||  15 |  16 |  17 |  18 | 19  |
//    \    20  | 21  | 22  |     ||     |  23 |  24 |  25   /
//                \    26  | 27  /\  28 |  29    /
//                 --------------  --------------
